## config/west.yml
```yaml
manifest:
  remotes:
    - name: github
      url-base: https://github.com
  projects:
    - name: zmk
      remote: github
      repo-path: zmkfirmware/zmk
      revision: v0.2.1
      import: app/west.yml
    - name: zmk-nice-oled
      remote: github
      repo-path: mctechnology17/zmk-nice-oled
      revision: main
```
